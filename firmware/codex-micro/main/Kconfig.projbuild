## firmware/codex-micro/main/Kconfig.projbuild
```kconfig
menu "Codex Micro board bring-up"
config CODEX_MAINBOARD_BRINGUP
    bool "Mainboard-only diagnostic firmware (no physical input reports)"
    default y
    help
        Keep USB/CDC, raw input diagnostics and explicit USB firmware maintenance.
        Disable business input reports, local gestures, BLE and lighting outputs.
        Disable this only for a deliberately built full peripheral firmware.
config CODEX_BOARD_SERVICES
    bool "Enable config maintenance and BLE while physical inputs remain suppressed"
    default y
    help
        Enables explicit configuration RPC, controlled reboot, Host state handling
        and BLE bonding tests. Does not enable raw input actions or lighting output.
config CODEX_USB_MICROPHONE
    bool "INMP441 left-channel USB microphone (GPIO12/13/14, L/R grounded)"
    default y
    help
        Append UAC2 microphone interfaces to HID+CDC. 48 kHz mono PCM16.
        Independent of the switch/joystick diagnostic suppression policy.
endmenu
```

## firmware/codex-micro/sdkconfig.defaults
```kconfig
# Codex Micro — ESP32-S3 USB HID + CDC 复合设备
# TinyUSB：1 个 HID 接口 + 1 个 CDC ACM 接口（日志）
CONFIG_TINYUSB_HID_COUNT=2
CONFIG_TINYUSB_CDC_ENABLED=y
CONFIG_TINYUSB_CDC_COUNT=1

# 控制台固定用 UART0（USB-Serial/JTAG 与 USB OTG 共用 GPIO19/20，
# 用 TinyUSB HID 时必须避免把控制台放到 USB-Serial/JTAG 上）
CONFIG_ESP_CONSOLE_UART_DEFAULT=y

CONFIG_ESPTOOLPY_FLASHSIZE_16MB=y
CONFIG_PARTITION_TABLE_CUSTOM=y
CONFIG_PARTITION_TABLE_CUSTOM_FILENAME="partitions.csv"
CONFIG_BOOTLOADER_APP_ROLLBACK_ENABLE=y
CONFIG_BT_ENABLED=y
CONFIG_BT_NIMBLE_ENABLED=y
CONFIG_BT_NIMBLE_NVS_PERSIST=y
CONFIG_BT_NIMBLE_MAX_BONDS=3
CONFIG_BT_NIMBLE_MAX_CONNECTIONS=1
CONFIG_BT_NIMBLE_ATT_PREFERRED_MTU=128
CONFIG_BT_NIMBLE_HOST_TASK_STACK_SIZE=6144
# CONFIG_BT_BLUEDROID_ENABLED is not set
CONFIG_BT_NIMBLE_ROLE_CENTRAL=y
# CONFIG_BT_NIMBLE_ROLE_OBSERVER is not set

CONFIG_BT_NIMBLE_GATT_CLIENT=y
CONFIG_BT_NIMBLE_MAX_CCCDS=16
# CONFIG_CODEX_MAINBOARD_BRINGUP is not set
CONFIG_CODEX_BOARD_SERVICES=y
CONFIG_CODEX_USB_MICROPHONE=y

CONFIG_SPIRAM=y
CONFIG_SPIRAM_MODE_OCT=y
# CONFIG_SPIRAM_MODE_QUAD is not set
CONFIG_SPIRAM_SPEED_80M=y
CONFIG_SPIRAM_BOOT_INIT=y
CONFIG_SPIRAM_USE_MALLOC=y
CONFIG_SPIRAM_ALLOW_BSS_SEG_EXTERNAL_MEMORY=y
CONFIG_SPIRAM_MALLOC_ALWAYSINTERNAL=1024
CONFIG_SPIRAM_MALLOC_RESERVE_INTERNAL=32768
CONFIG_RMT_TX_ISR_CACHE_SAFE=y
```
